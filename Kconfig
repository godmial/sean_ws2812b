## Kconfig
```kconfig
menuconfig PKG_SEAN_WS2812B
    bool "Sean's WS2812B LED Driver Package"
    default n
    select RT_USING_SPI
    help
        A lightweight and easy-to-use WS2812B RGB LED driver by Sean.

if PKG_SEAN_WS2812B

config SEAN_WS2812B_SPI_BUS_NAME
    string "SPI bus name (master)"
    default "spi1"
    help
        SPI bus (controller) name for WS2812B, e.g., 'spi1'.

config SEAN_WS2812B_SPI_DEV_NAME
    string "SPI device name (slave)"
    default "spi10"
    help
        SPI device name for WS2812B, e.g., 'spi10'.

config SEAN_WS2812B_SPI_CS_PORT
    string "SPI CS GPIO port"
    default "GPIOB"
    help
        SPI CS GPIO port for WS2812B, e.g., 'GPIOB'.

config SEAN_WS2812B_SPI_CS_PIN
    int "SPI CS GPIO pin number"
    default 12
    help
        SPI CS GPIO pin number for WS2812B, e.g., 12.

config SEAN_WS2812B_LED_NUMS
    int "Number of LEDs"
    default 5
    help
        Set the number of LEDs on the WS2812B strip. Default is 5.

config SEAN_WS2812B_USING_DEMO
    bool "Enable demo examples"
    default n
    help
        Enable demo application examples for WS2812B.

endif
```
